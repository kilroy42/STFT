#include "Arduino.h"

#include <stft.h>

/*
        Wiring of ILI9341 display:

        Display         Arduino
       ======================================================================================
        SDO/MISO        12 - fixed
        LED             +3.3V or PWM (Attention! Needs more than the max 40mA an Arduino pin can deliver!)
        SCK             13 - fixed
        SDI/MOSI        11 - fixed
        D/C             9 - fourth parameter below
        RESET           2 - third parameter below
        CS              10 - second parameter below
        GND             GND
        VCC             +3.3V


        Wiring of ST7735 display:
        
        Display         Arduino
       ======================================================================================
        GND             GND
        VCC             +3.3V
        RESET           2 - third parameter below
        AO              9 - fourth parameter below
        SDA             11 - fixed
        SCK             13 - fixed
        CS              10 - second parameter below
        LED+            +3.3V or PWM
        LED-            GND
*/

// ST7735 display
//#define WIDTH 128
//#define HEIGHT 160
//STFT tft(ST7735, 10, 2, 9);

// ILI9341 display
#define WIDTH 240
#define HEIGHT 320
STFT tft(ILI9341, 10, 2, 9);


static const uint8_t sinus_table[ 0x100 ] PROGMEM = {
  0x80, 0x7d, 0x7a, 0x77, 0x74, 0x70, 0x6d, 0x6a, 0x67, 0x64, 0x61, 0x5e, 0x5b, 0x58, 0x55, 0x52,
  0x4f, 0x4d, 0x4a, 0x47, 0x44, 0x41, 0x3f, 0x3c, 0x39, 0x37, 0x34, 0x32, 0x2f, 0x2d, 0x2b, 0x28,
  0x26, 0x24, 0x22, 0x20, 0x1e, 0x1c, 0x1a, 0x18, 0x16, 0x15, 0x13, 0x11, 0x10, 0x0f, 0x0d, 0x0c,
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  0xb1, 0xae, 0xab, 0xa8, 0xa5, 0xa2, 0x9f, 0x9c, 0x99, 0x96, 0x93, 0x90, 0x8c, 0x89, 0x86, 0x83,
};

const uint16_t color_table[] PROGMEM = {
  0xf800, 0xf820, 0xf860, 0xf880, 0xf8c0, 0xf8e0, 0xf920, 0xf940, 0xf980, 0xf9a0, 0xf9e0, 0xfa00, 0xfa40, 0xfa60, 0xfaa0, 0xfac0,
  0xfb00, 0xfb20, 0xfb60, 0xfb80, 0xfbc0, 0xfbe0, 0xfc20, 0xfc40, 0xfc80, 0xfca0, 0xfce0, 0xfd00, 0xfd40, 0xfd60, 0xfda0, 0xfdc0,
  0xfe00, 0xfe20, 0xfe60, 0xfe80, 0xfec0, 0xfee0, 0xff20, 0xff40, 0xff80, 0xffa0, 0xffe0, 0xffe0, 0xffe0, 0xf7e0, 0xefe0, 0xe7e0,
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  0xf80c, 0xf80b, 0xf80a, 0xf80a, 0xf809, 0xf808, 0xf807, 0xf807, 0xf806, 0xf805, 0xf804, 0xf804, 0xf803, 0xf802, 0xf801, 0xf801,
};

#define trans(v) { SPDR = v; __asm__("nop"); __asm__("nop"); __asm__("nop"); __asm__("nop"); __asm__("nop"); __asm__("nop"); __asm__("nop"); __asm__("nop"); __asm__("nop"); __asm__("nop"); __asm__("nop"); __asm__("nop"); __asm__("nop"); __asm__("nop"); __asm__("nop"); __asm__("nop"); }
#define trans2(v) { SPDR = v; }

void image()
{
  static uint8_t c1a, c1b;
  static uint8_t c2a, c2b;
  static uint8_t c1A, c1B;
  static uint8_t c2A, c2B;
  static uint8_t offset = 0;
  static uint8_t xbuf[240]; // we could malloc the right size, but this would include malloc, which is another 500 byte
  static uint8_t ybuf[320];


  uint8_t index;
  uint16_t color;

  uint8_t x;
  uint16_t y;

  tft.startRaw((tft.width - WIDTH)/2, (tft.height - HEIGHT)/2, (tft.width + WIDTH)/2 - 1, (tft.height + HEIGHT)/2 - 1);
  
  c1a = c1A;
  c1b = c1B;
  for ( y = 0; y < HEIGHT; ++y )
  {
    ybuf[ y ] = ( pgm_read_byte(&sinus_table[ c1a ]) + pgm_read_byte(&sinus_table[ c1b ]) ) >> 1;
    c1a += 1;
    c1b += 2;
  }
  c1A += 2;
  c1B -= 3;

  c2a = c2A;
  c2b = c2B;
  for ( x = 0; x < WIDTH; ++x )
  {
    xbuf[ x ] = ( pgm_read_byte(&sinus_table[ c2a ]) + pgm_read_byte(&sinus_table[ c2b ]) ) >> 1;
    c2a += 1;
    c2b += 2;
  }
  c2A -= 4;
  c2B += 1;

  for ( y = 0; y < HEIGHT; ++y )
  {
    for ( x = 0; x < WIDTH; ++x )
    {
      index = ( ( xbuf[ x ] + ybuf[ y ] ) >> 1 ) + offset;

      color = pgm_read_word(&color_table[index]);

      SPIFastWrite(color >> 8); NOP; NOP; NOP; NOP; NOP; NOP; NOP; NOP; NOP; NOP; NOP; NOP; NOP; NOP; NOP; NOP; NOP; // 17 NOPs
      SPIFastWrite(color&0xFF);
    }
  }

  offset++;

  tft.endRaw();
}

void setup()
{                
  Serial.begin(9600);

  tft.init();
  tft.clrScr();
}

uint32_t cnt = 0;

void loop()
{
  image();

  cnt+= 1;

  if ((cnt&15) == 0)
    Serial.println(micros() / cnt, DEC);
}


